## meta-custom/conf/layer.conf
```bitbake
# We have a conf and classes directory, append to BBPATH
BBPATH .= ":${LAYERDIR}"

# We have a recipes directory, add to BBFILES
BBFILES += "${LAYERDIR}/recipes*/*/*.bb ${LAYERDIR}/recipes*/*/*.bbappend"

BBFILE_COLLECTIONS += "meta-custom"
BBFILE_PATTERN_meta-custom := "^${LAYERDIR}/"
BBFILE_PRIORITY_meta-custom = "10"

LAYERSERIES_COMPAT_meta-custom = "thud"
```
